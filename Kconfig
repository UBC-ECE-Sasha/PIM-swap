## config/packages/upmem_driver/Config.in
```kconfig
config BR2_PACKAGE_UPMEM_DRIVER
        bool "upmem_driver"
        help
          UPMEM Driver
```

## config/pimswap/Config.in
```kconfig
config BR2_PACKAGE_PIMSWAP
	bool "pimswap package"
	depends on BR2_LINUX_KERNEL_EXT_PIMSWAP
	select BR2_PACKAGE_UPMEM_DRIVER 
	help
		PIMswap swapper
```

## config/qemu_pim_defconfig
```kconfig
BR2_x86_64=y
BR2_TARGET_GENERIC_ROOT_PASSWD="root"
BR2_TARGET_GENERIC_HOSTNAME="wolf"
BR2_TARGET_GENERIC_ISSUE="PIM swapping on Wolf"
BR2_SYSTEM_DHCP="eth0"
BR2_ROOTFS_OVERLAY="rootfs_overlay/"
BR2_ROOTFS_POST_BUILD_SCRIPT="board/upmem/post-build.sh"
BR2_ROOTFS_POST_IMAGE_SCRIPT="board/upmem/post-image.sh"
BR2_ROOTFS_POST_SCRIPT_ARGS="$(BR2_DEFCONFIG)"
BR2_LINUX_KERNEL=y
BR2_LINUX_KERNEL_CUSTOM_VERSION=y
BR2_LINUX_KERNEL_CUSTOM_VERSION_VALUE="5.4.95"
BR2_PACKAGE_HOST_LINUX_HEADERS_CUSTOM_5_4=y
BR2_LINUX_KERNEL_USE_CUSTOM_CONFIG=y
BR2_LINUX_KERNEL_CUSTOM_CONFIG_FILE="board/upmem/linux.config"
BR2_LINUX_KERNEL_CONFIG_FRAGMENT_FILES="linux_config/pimswap.cfg"
BR2_PACKAGE_OPENSSH=y
BR2_TARGET_ROOTFS_CPIO=y
BR2_TARGET_ROOTFS_CPIO_GZIP=y
BR2_PACKAGE_UPMEM_DRIVER=y
BR2_LINUX_KERNEL_EXT_PIMSWAP=y
BR2_PACKAGE_PIMSWAP=y
BR2_PACKAGE_STRESS_NG=y
BR2_PACKAGE_MEMSTAT=y
BR2_PACKAGE_MEMSTAT=y
BR2_COMPILER_PARANOID_UNSAFE_PATH=n
#BR2_TARGET_ROOTFS_EXT2=y
BR2_TOOLCHAIN=y
BR2_TOOLCHAIN_USES_GLIBC=y
BR2_TOOLCHAIN_BUILDROOT=y
BR2_TOOLCHAIN_BUILDROOT_VENDOR="buildroot"
BR2_TOOLCHAIN_BUILDROOT_GLIBC=y
BR2_TOOLCHAIN_BUILDROOT_LIBC="glibc"
BR2_TOOLCHAIN_BUILDROOT_CXX=y
BR2_PACKAGE_LIBABSEIL_CPP_ARCH_SUPPORTS=y
BR2_INSTALL_LIBSTDCPP=y
BR2_TOOLCHAIN_HAS_THREADS=y
BR2_PACKAGE_HOST_GDB_ARCH_SUPPORTS=y
R2_GDB_VERSION="9.2"
BR2_PACKAGE_GDB_ARCH_SUPPORTS=y
BR2_PACKAGE_GDB=y
BR2_PACKAGE_GDB_SERVER=y
BR2_PACKAGE_GDB_DEBUGGER=y
```

## config/wiredtiger/Config.in
```kconfig
config BR2_PACKAGE_WIREDTIGER
        bool "wiredtiger"
        help
          wiredtiger storage engine

          http://source.wiredtiger.com/
```
